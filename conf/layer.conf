## conf/layer.conf
```bitbake
# We have a conf and classes directory, append to BBPATH
BBPATH .= ":${LAYERDIR}"

# We have a recipes directory, add to BBFILES
BBFILES += "${LAYERDIR}/recipes-*/*/*.bb ${LAYERDIR}/recipes-*/*/*.bbappend"
BBFILES += "${LAYERDIR}/recipes-*/*/*/*.bb ${LAYERDIR}/recipes-*/*/*/*.bbappend"

BBFILE_COLLECTIONS += "provenrun"

# The following versions have been tested successfully on Ubuntu 18.04
LAYERSERIES_COMPAT_provenrun  = "honister"

BBFILE_PATTERN_provenrun := "^${LAYERDIR}/"
```
